## conf/distro/poky-qtec.conf
```bitbake
require conf/distro/poky.conf

DISTRO = "poky-qtec"
DISTRO_NAME = "Poky Qtec 1.0 (Based Yocto Project 2.1.1 Reference Distro)"
DISTRO_CODENAME = "cesium"

MAINTAINER = "Qtec yocto admin <yocto@qtec.com>"

SANITY_TESTED_DISTROS += "Debian-testing\n"
SANITY_TESTED_DISTROS += "Debian-7.4\n"
SANITY_TESTED_DISTROS += "Debian-7.5\n"
SANITY_TESTED_DISTROS += "Debian-7.6\n"
SANITY_TESTED_DISTROS += "Debian-7.7\n"
SANITY_TESTED_DISTROS += "Debian-8.0\n"

PREFERRED_PROVIDER_jpeg ?= "libjpeg-turbo"
PREFERRED_PROVIDER_jpeg-native ?= "libjpeg-turbo-native"
PREFERRED_PROVIDER_virtual/fftw ?= "fftw"

PREFERRED_VERSION_gstreamer1.0 ?= "1.10.%"
PREFERRED_VERSION_gstreamer1.0-plugins-base ?= "1.10.%"
PREFERRED_VERSION_gstreamer1.0-plugins-good ?= "1.10.%"
PREFERRED_VERSION_gstreamer1.0-plugins-bad ?= "1.10.%"
PREFERRED_VERSION_gstreamer1.0-plugins-ugly ?= "1.10.%"
PREFERRED_VERSION_gstreamer1.0-libav ?= "1.10.%"

PREFERRED_VERSION_opencv ?= "3.%"

#Modified from ./yocto/meta/conf/distro/include/default-distrovars.inc
DISTRO_FEATURES_DEFAULT = "alsa argp ext2 largefile usbgadget usbhost wifi xattr nfs zeroconf pci nfc x11"
DISTRO_FEATURES_remove = "wayland"
```

## conf/layer.conf
```bitbake
# We have a conf and classes directory, add to BBPATH
BBPATH .= ":${LAYERDIR}"

# We have recipes-* directories, add to BBFILES
BBFILES += "${LAYERDIR}/recipes-*/*/*.bb \
	${LAYERDIR}/recipes-*/*/*.bbappend"

BBFILE_COLLECTIONS += "qtec-core"
BBFILE_PATTERN_qtec-core = "^${LAYERDIR}/recipes"
BBFILE_PRIORITY_qtec-core = "5"

LAYERDEPENDS_qtec-core = "qtec-core-meta-oe"
```

## conf/machine/include/qt5022.inc
```bitbake
include conf/machine/include/ia32-base.inc
require conf/machine/include/tune-amd-bobcat.inc

MACHINE_FEATURES += "wifi efi pcbios acpi"
IMAGE_FSTYPES = "tar.gz"

PREFERRED_PROVIDER_virtual/kernel = "linux-qtec"
PREFERRED_RPROVIDER_java2-runtime = "openjre-8"
PREFERRED_PROVIDER_virtual/java-initial-native = "cacao-initial-native"
PREFERRED_PROVIDER_virtual/java-native = "cacao-native"

MACHINE_ESSENTIAL_EXTRA_RDEPENDS += "grub-files"

PREFERRED_VERSION_linux-libc-headers = "4.8.%"

XSERVER = " \
	    xserver-xorg \
	    xf86-input-mouse \
	    xf86-input-keyboard \
	    xf86-input-evdev \
	    xserver-xorg-extension-dri \
	    xserver-xorg-extension-dri2 \
	    xserver-xorg-extension-extmod \
	    xserver-xorg-extension-dbe \
	    xserver-xorg-module-libint10 \
	    "

MACHINE_EXTRA_RRECOMMENDS += " linux-firmware-iwlwifi-6000g2a-5 linux-firmware-iwlwifi-6000g2b-6 v86d kernel-firmware kernel-modules clinfo"

SERIAL_CONSOLE = ""

GLIBC_ADDONS = "nptl"

EXTRA_OECONF_append_pn-matchbox-panel-2 = " --with-battery=acpi"

KERNEL_IMAGETYPE = "bzImage"
```

## conf/machine/include/tune-amd-bobcat.inc
```bitbake
DEFAULTTUNE ?= "bobcat-64"

require conf/machine/include/x86/arch-x86.inc

#Bobcat ABI
TUNEVALID[bobcat] = "Bobcat"
TUNE_CCARGS += "${@bb.utils.contains("TUNE_FEATURES", "bobcat", "-march=btver1 -mtune=btver1", "", d)}"


AVAILTUNES += "bobcat-64"
TUNE_FEATURES_tune-bobcat-64 = "bobcat m64"
BASE_LIB_tune-bobcat-64 = "lib64"
TUNE_PKGARCH_tune-bobcat-64 = "bobcat_64"
PACKAGE_EXTRA_ARCHS_tune-bobcat-64 = "${TUNE_PKGARCH_tune-bobcat-64}"
QEMU_EXTRAOPTIONS_bobcat_64 = "-cpu Opteron_G4,check=false"
```

## conf/machine/qt5022-fglrx.conf
```bitbake
#@TYPE: Machine
#@NAME: Qt5022-fglrx

#@DESCRIPTION: Machine configuration for qt5022 systems

include conf/machine/include/qt5022.inc

PREFERRED_PROVIDER_virtual/libgl = "xf86-video-fglrx"
PREFERRED_PROVIDER_virtual/opencl-icd = "amdappsdk"
PREFERRED_PROVIDER_virtual/libgles1 = "fglrx-libgles"
PREFERRED_PROVIDER_virtual/libgles2 = "fglrx-libgles"
PREFERRED_PROVIDER_virtual/egl = "fglrx-libgles"
PREFERRED_VERSION_xserver-xorg = "1.17.%"
PREFERRED_VERSION_mesa = "11.1.1"

XSERVER += "xf86-video-fglrx"
```

## conf/machine/qt5022-open.conf
```bitbake
#@TYPE: Machine
#@NAME: Qt5022-open

#@DESCRIPTION: Machine configuration for qt5022 systems
require conf/machine/include/qt5022.inc

PREFERRED_PROVIDER_virtual/libgl = "mesa"
PREFERRED_PROVIDER_virtual/libgles1 = "mesa"
PREFERRED_PROVIDER_virtual/libgles2 = "mesa"
PREFERRED_PROVIDER_virtual/egl = "mesa"
PREFERRED_PROVIDER_virtual/opencl-icd = "ocl-icd"
PREFERRED_VERSION_mesa = "12.%"
PREFERRED_VERSION_xserver-xorg = "1.18.%"
PREFERRED_VERSION_gstreamer1.0-omx = "1.10.%"

XSERVER += "\
	    xf86-video-ati \
	    "
MACHINE_EXTRA_RRECOMMENDS += "mesa-driver-pipe-swrast mesa-driver-pipe-r600 mesa-driver-pipe-radeonsi libclc libtxc-dxtn libomx-mesa libmesaopencl linux-firmware-radeon"
```

## meta-oe/conf/layer.conf
```bitbake
# We have a conf and classes directory, add to BBPATH
BBPATH := "${BBPATH}:${LAYERDIR}"

# We have a recipes directory, add to BBFILES
BBFILES := "${BBFILES} ${LAYERDIR}/recipes-*/*/*.bb \
            ${LAYERDIR}/recipes-*/*/*.bbappend"

BBFILE_COLLECTIONS += "qtec-core-meta-oe"
BBFILE_PATTERN_qtec-core-meta-oe := "^${LAYERDIR}/recipes"
BBFILE_PRIORITY_qtec-core-meta-oe = "5"

LAYERDEPENDS_qtec-core-meta-oe = "qtec-core"

LICENSE_PATH += "${LAYERDIR}/licenses"
```
